## firmware/terminal/sdkconfig.defaults
```kconfig
# 小智终端 sdkconfig 默认配置（合并进 xiaozhi-esp32 工程）

# ---- Flash / Partition ----
CONFIG_ESPTOOLPY_FLASHSIZE_4MB=y
CONFIG_PARTITION_TABLE_CUSTOM=y
CONFIG_PARTITION_TABLE_CUSTOM_FILENAME="partitions.csv"

# ---- WiFi ----
CONFIG_ESP_WIFI_ENABLED=y
CONFIG_ESP_WIFI_PHY_TX_POWER=20

# ---- MQTT ----
CONFIG_MQTT_PROTOCOL_311=y

# ---- BLE（蓝牙低功耗，NimBLE 主机栈） ----
CONFIG_BT_ENABLED=y
CONFIG_BT_NIMBLE_ENABLED=y
CONFIG_BT_NIMBLE_MAX_CONNECTIONS=8

# ---- 移动底盘（电机 PWM / 编码器 PCNT） ----
CONFIG_LEDC_CTRL_FREQ=20000
CONFIG_PCNT_ISR_IRAM_SAFE=y

# ---- 电源管理 ----
CONFIG_PM_ENABLE=y
CONFIG_PM_DFS_INTERVAL=1000

# ---- 日志 ----
CONFIG_LOG_DEFAULT_LEVEL_INFO=y
```
